## boards/shields/prospector_adapter/src/layouts/briefing/Kconfig.defconfig
```kconfig
if PROSPECTOR_STATUS_SCREEN_BRIEFING

config ZMK_DISPLAY_STATUS_SCREEN_CUSTOM
    select LV_USE_LABEL
    select LV_USE_FLEX
    select LV_USE_ARC
    select LV_USE_BAR
    select LV_USE_LINE
    select LV_COLOR_SCREEN_TRANSP

config ZMK_WPM
    default y

config LV_Z_MEM_POOL_SIZE
    default 24000

endif
```
